## firmware/sdkconfig.defaults
```kconfig
# Cardputer ADV = ESP32-S3FN8: 8 MB flash, 512 KB SRAM, NO PSRAM.
CONFIG_IDF_TARGET="esp32s3"
CONFIG_ESPTOOLPY_FLASHSIZE_8MB=y

# Custom partition table (3 MB app + FAT storage).
CONFIG_PARTITION_TABLE_CUSTOM=y
CONFIG_PARTITION_TABLE_CUSTOM_FILENAME="partitions.csv"

# Our portable C++ uses std::string/vector/function; enable exceptions + RTTI so
# a throw (bad_alloc, stoi, vector::at) doesn't hard-abort. We have flash to spare.
CONFIG_COMPILER_CXX_EXCEPTIONS=y
CONFIG_COMPILER_CXX_RTTI=y
CONFIG_COMPILER_OPTIMIZATION_SIZE=y

# app_main runs the whole UI loop; give it headroom for std::string temporaries
# and SQLite/FTS5 query call depth.
CONFIG_ESP_MAIN_TASK_STACK_SIZE=20480
CONFIG_FREERTOS_HZ=1000

# FATFS long filenames (our paths like /journal/2026-06-23.txt exceed 8.3); LFN
# buffer on the heap so we don't grow every task's stack.
CONFIG_FATFS_LFN_HEAP=y
CONFIG_FATFS_MAX_LFN=255

# Task watchdog: the main UI task and the radio task subscribe themselves and
# reset each loop, so a real freeze (deadlock, stuck SX1262 BUSY on the shared
# SPI2 bus) trips the WDT -> panic -> reboot instead of a silent hang. 30 s is
# deliberately generous: the only long synchronous op on the main task is a wiki
# FTS5 search, and a true hang is infinite, so this still recovers it.
CONFIG_ESP_TASK_WDT_TIMEOUT_S=30

# SQLite compiles with NDEBUG (see main/sqlite3_esp32.c). IDF's default assert.h
# still *evaluates* assert() expressions under NDEBUG, which trips on SQLite's
# SQLITE_DEBUG-only member references; make NDEBUG a true no-op instead. Only
# affects TUs that define NDEBUG (i.e. the SQLite amalgamation).
CONFIG_COMPILER_ASSERT_NDEBUG_EVALUATE=n
```
